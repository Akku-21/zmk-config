#define CONFIG_WIRELESS
#define ZMK_BASE_LAYER(name, LT, RT, LM, RM, LB, RB, LH, RH)                   \
    ZMK_LAYER(                                                                 \
        name,                                                                  \
                 LT                &none        RT                                                         \
                 LM         &none  &none  &none RM                                                         \
                 LB &none          &none        RB                                                         \
       &none &kp LGUI LH RH &smart_mouse &none                                            \
    )

#include "zmk-helpers/key-labels/eyelash42.h"
#include "base.keymap"

/{ chosen { zmk,physical-layout = &foostan_corne_5col_layout; }; };
